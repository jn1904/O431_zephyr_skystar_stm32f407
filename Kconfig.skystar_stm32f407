## Kconfig.skystar_stm32f407
```kconfig
# SPDX-License-Identifier: MIT

config BOARD_SKYSTAR_STM32F407
	select SOC_STM32F407XE
```

## board.yml
```yaml
board:
  name: skystar_stm32f407
  full_name: Skystar STM32F407VET6 Development Board
  vendor: O431
  socs:
    - name: stm32f407xx
```

## boards/skystar_stm32f407/Kconfig.defconfig
```kconfig
# skystar_stm32f407 board configuration

# SPDX-License-Identifier: MIT

if BOARD_SKYSTAR_STM32F407

config SPI_STM32_INTERRUPT
	default y
	depends on SPI

endif # BOARD_SKYSTAR_STM32F407
```

## boards/skystar_stm32f407/board.yml
```yaml
board:
  name: skystar_stm32f407
  full_name: LCKFB SkyStar STM32F407VET6 Baseboard
  vendor: O431
  socs:
    - name: stm32f407xx
```

## boards/skystar_stm32f407vet6/Kconfig.defconfig
```kconfig
# SPDX-License-Identifier: MIT

if BOARD_SKYSTAR_STM32F407VET6

config SPI_STM32_INTERRUPT
default y
depends on SPI

endif # BOARD_SKYSTAR_STM32F407VET6
```

## boards/skystar_stm32f407vet6/Kconfig.skystar_stm32f407vet6
```kconfig
# SPDX-License-Identifier: MIT

config BOARD_SKYSTAR_STM32F407VET6
select SOC_STM32F407XE
```

## boards/skystar_stm32f407vet6/board.yml
```yaml
board:
  name: skystar_stm32f407vet6
  full_name: LCKFB SkyStar STM32F407VET6 Core Board
  vendor: O431
  socs:
    - name: stm32f407xx
```
